//
// HX1230/STE2007 LCD Library
// Copyright (c) 2018-2019 BitBank Software, Inc.
// Written by Larry Bank
// Project started 2/23/2018
//
// This program is free software: you can redistribute it and/or modify
// it under the terms of the GNU General Public License as published by
// the Free Software Foundation, either version 3 of the License, or
// (at your option) any later version.
//
// This program is distributed in the hope that it will be useful,
// but WITHOUT ANY WARRANTY; without even the implied warranty of
// MERCHANTABILITY or FITNESS FOR A PARTICULAR PURPOSE.  See the
// GNU General Public License for more details.
//
// You should have received a copy of the GNU General Public License
// along with this program.  If not, see <http://www.gnu.org/licenses/>.
//

#include <Arduino.h>
void delay_us(uint16_t);
#ifdef __AVR__
#include <avr/pgmspace.h>
#endif
#include <bb_hx1230.h>

// small font
const byte ucFont[]PROGMEM = {
  0x00,0x00,0x00,0x00,0x00,0x00,0x00,0x00,0x00,0x00,0x06,0x5f,0x5f,0x06,0x00,0x00,
  0x00,0x07,0x07,0x00,0x07,0x07,0x00,0x00,0x14,0x7f,0x7f,0x14,0x7f,0x7f,0x14,0x00,
  0x24,0x2e,0x2a,0x6b,0x6b,0x3a,0x12,0x00,0x46,0x66,0x30,0x18,0x0c,0x66,0x62,0x00,
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  0x02,0x03,0x01,0x03,0x02,0x03,0x01,0x00,0x70,0x78,0x4c,0x46,0x4c,0x78,0x70,0x00};
// Assume that we don't want to add another 6K of FLASH on AVR MCUs
// and instead will stretch the 8x8 font to 16x16
#ifndef __AVR__
const byte ucBigFont[]PROGMEM = {
  0x00,0x00,0x00,0x00,0x00,0x00,0x00,0x00,0x00,0x00,0x00,0x00,0x00,0x00,0x00,0x00,
  0x00,0x00,0x00,0x00,0x00,0x00,0x00,0x00,0x00,0x00,0x00,0x00,0x00,0x00,0x00,0x00,
  0x00,0x00,0x00,0x00,0x00,0x00,0x00,0x00,0x00,0x00,0x00,0x00,0x00,0x00,0x00,0x00,
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  0x00,0x00,0x00,0x00,0x00,0x00,0x00,0x00,0x00,0x00,0x00,0x00,0x00,0x00,0x00,0x00};
#endif // !__AVR__
  // 5x7 font (in 6x8 cell)
const byte ucSmallFont[]PROGMEM = {
  0x00,0x00,0x00,0x00,0x00,0x00,0x00,0x00,0x06,0x5f,0x06,0x00,0x00,0x07,0x03,0x00,
  0x07,0x03,0x00,0x24,0x7e,0x24,0x7e,0x24,0x00,0x24,0x2b,0x6a,0x12,0x00,0x00,0x63,
  0x13,0x08,0x64,0x63,0x00,0x36,0x49,0x56,0x20,0x50,0x00,0x00,0x07,0x03,0x00,0x00,
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  0x41,0x41,0x3e,0x08,0x00,0x02,0x01,0x02,0x01,0x00,0x00,0x3c,0x26,0x23,0x26,0x3c};

static int iScreenOffset; // current write offset of screen data
#ifdef BACKING_RAM
static unsigned char ucScreen[864]; // local copy of the image buffer
#endif
static uint8_t iCSPin, iDataPin, iClockPin, iResetPin, iLEDPin;
static void hx1230WriteCommand(unsigned char c);

//
// SPI 3-wire transfers the D/C bit first, then 8-bits MSB first
// and latches the bits on the falling edge of the clock
// (idle low)
//
#ifdef __AVR_ATtiny85__
void bb_spi_transfer(byte *pBuf, byte bLen, byte bDC)
{
byte i, b, c;
   if (iCSPin != -1)
      PORTB &= ~(1<<iCSPin); // write CS low
   for (i=0; i<bLen; i++)
   {
      c = *pBuf++;
      // Write D/C bit
      if (bDC)
         PORTB |= (1<<iDataPin);
      else
         PORTB &= ~(1<<iDataPin); // set data type (MSB first)
      PORTB |= (1<<iClockPin); // toggle clock
      delay_us(1);
      PORTB &= ~(1<<iClockPin); // high->low transition latches data

      for (b=0; b<8; b++)
      {
         if (c & 0x80)
            PORTB |= (1<<iDataPin); // faster to do direct bit manipulation on the ATtiny85
         else                       // than to call digitalWrite()
            PORTB &= ~(1<<iDataPin);
         PORTB |= (1<<iClockPin);
         delay_us(1);
         PORTB &= ~(1<<iClockPin);
         c <<= 1; // shift over data
      } // for each bit
   } // for each byte
   if (iCSPin != -1)
      PORTB |= (1<<iCSPin); // CS high (disactivate)
} /* bb_spi_transfer() */
#else
void bb_spi_transfer(byte *pBuf, byte bLen, byte bDC)
{
byte i, b, c;
   if (iCSPin != 0xff)
      digitalWrite(iCSPin, LOW);
   for (i=0; i<bLen; i++)
   {
      c = *pBuf++;
      // Write D/C bit
      digitalWrite(iDataPin, bDC); // set data bit (MSB first)
      digitalWrite(iClockPin, HIGH); // toggle clock
      digitalWrite(iClockPin, LOW); // high->low transition latches data
      
      for (b=0; b<8; b++)
      {
         digitalWrite(iDataPin, (c & 0x80)); // set data bit (MSB first)
         digitalWrite(iClockPin, HIGH); // toggle clock
         digitalWrite(iClockPin, LOW); // high->low transition latches data
         c <<= 1; // shift over data
      } // for each bit
   } // for each byte
   if (iCSPin != 0xff)
      digitalWrite(iCSPin, HIGH);
} /* bb_spi_transfer() */
#endif

void hx1230PowerUp(void)
{
const unsigned char ucPowerUp[] = {0x2f, 0x90, 0xa6, 0xa4, 0xaf, 0x40, 0xb0, 0x10, 0x00};
   bb_spi_transfer((unsigned char *)ucPowerUp, sizeof(ucPowerUp), 0); // send command sequence
} /* hx1230PowerUp() */
//
// Initializes the LCD controller into "horizontal write mode"
// Prepares the font data for the orientation of the display
// Parameters: GPIO pin numbers used for the DC/RST/LED control lines
//
void hx1230Init(uint8_t iReset, uint8_t iLED, uint8_t iCS, uint8_t iClock, uint8_t iData, uint8_t bFlip180, uint8_t bInvert)
{

   iCSPin = iCS;
   iClockPin = iClock;
   iDataPin = iData;
   iResetPin = iReset;
   iLEDPin = iLED;

#ifdef __AVR_ATtiny85__
   DDRB |= (1<<iClockPin); // set as output
   PORTB &= ~(1<<iClockPin); // idle low
   DDRB |= (1<<iDataPin); // set as output
   DDRB |= (1<<iResetPin);
   if (iCSPin != 0xff) // -1 == not used
        DDRB |= (1<<iCSPin);
   if (iLEDPin != 0xff) // -1 == not used
        DDRB |= (1<<iLEDPin);

  // Start by reseting the LCD controller
   PORTB |= (1<<iResetPin); // toggle reset
   delay_us(50000);
   PORTB &= ~(1<<iResetPin);
   delay_us(5000);
   PORTB |= (1<<iResetPin); // take it out of reset
   delay_us(10000);
#else
   pinMode(iClockPin, OUTPUT);
   digitalWrite(iClockPin, LOW); // idle low
   pinMode(iDataPin, OUTPUT);
        pinMode(iResetPin, OUTPUT);
   if (iCSPin != 0xff) // -1 == not used
        pinMode(iCSPin, OUTPUT);
   if (iLEDPin != 0xff) // -1 == not used
        pinMode(iLEDPin, OUTPUT);

  // Start by reseting the LCD controller
   digitalWrite(iResetPin, HIGH);
   delay(50);
   digitalWrite(iResetPin, LOW);
   delay(5);
   digitalWrite(iResetPin, HIGH); // take it out of reset
   delay(10);
#endif

   hx1230Backlight(1); // turn on the backlight
   hx1230PowerUp(); // turn on and initialize the display

   if (bFlip180) // flip horizontal + vertical
   {
      hx1230WriteCommand(0xa1); // set SEG direction (A1 to flip horizontal)
      hx1230WriteCommand(0xc8); // set COM direction (C8 to flip vert)
   }
   if (bInvert)
   {
      hx1230WriteCommand(0xa7); // set inverted pixel mode
   }
   hx1230Fill(0); // erase memory
   hx1230SetContrast(0); // any other value seems to be too high

} /* hx1230Init() */

// Controls the LED backlight
void hx1230Backlight(uint8_t bOn)
{
  if (iLEDPin != 0xff)
  {
#ifdef __AVR_ATtiny85__
     if (bOn)
        PORTB |= (1<<iLEDPin);
     else
        PORTB &= ~(1<<iLEDPin);
#else
     digitalWrite(iLEDPin, (bOn) ? HIGH:LOW);
#endif
  }
} /* hx1230Backlight() */

//
// Sends a command to turn off the LCD display
//
void hx1230PowerDown()
{
    hx1230Fill(0); // fill memory with zeros to go to lowest power mode
    hx1230Backlight(0); // turn off the backlight
    hx1230WriteCommand(0xae); // power down
//    hx1230WriteCommand(0xa5); // all pixels on (saves power)
}

static void hx1230WriteCommand(unsigned char c)
{
   bb_spi_transfer(&c, 1, 0);
} /* hx1230WriteCommand() */

//
// 32 contrast levels (0-31)
//
int hx1230SetContrast(unsigned char ucContrast)
{
  if (ucContrast > 31) ucContrast = 31;
  hx1230WriteCommand(0x80 + ucContrast); // set contrast
  return 0;
} /* hx1230SetContrast() */

// Send commands to position the "cursor" to the given
// row and column
static void hx1230SetPosition(uint8_t x, uint8_t y)
{
unsigned char ucTemp[3];

#ifdef BACKING_RAM
  if (x > 95 || y > 8)
     return; // invalid
  iScreenOffset = (y*96)+x;
#endif
  ucTemp[0] = 0xb0 | y; // set Y
  ucTemp[1] = 0x10 | (x >> 4); // set X MSB
  ucTemp[2] = 0x00 | (x & 0xf); // set X LSB
  bb_spi_transfer(ucTemp, 3, 0); // send 3 byte commands
}

// Write a block of pixel data to the LCD
// Length can be anything from 1 to 504 (whole display)
static void hx1230WriteDataBlock(unsigned char *ucBuf, int iLen)
{

#ifdef BACKING_RAM
  if (iScreenOffset < 0 || iScreenOffset+iLen > sizeof(ucScreen))
     return; // invalid
   Keep a copy in local buffer
  memcpy(&ucScreen[iScreenOffset], ucBuf, iLen);
  iScreenOffset += iLen;
#endif
  bb_spi_transfer(ucBuf, iLen, 1);
} /* hx1230WriteDataBlock() */

//
// Load a 96x68 1-bpp Windows bitmap
// Pass the pointer to the beginning of the BMP file
// First pass version assumes a full screen bitmap
//
int hx1230LoadBMP(byte *pBMP)
{
int16_t i16;
int iOffBits, q, y, j; // offset to bitmap data
int iPitch;
byte x, z, b, *s;
byte dst_mask;
byte ucTemp[32]; // process 32 bytes at a time
byte bFlipped = false;

  i16 = pgm_read_word(pBMP);
  if (i16 != 0x4d42) // must start with 'BM'
     return -1; // not a BMP file
  i16 = pgm_read_word(pBMP + 18);
  if (i16 != 96) // must be 96 pixels wide
     return -1;
  i16 = pgm_read_word(pBMP + 22);
  if (i16 != 68 && i16 != -68) // must be 68 pixels tall
     return -1;
  if (i16 == 68) // BMP is flipped vertically (typical)
     bFlipped = true;
  i16 = pgm_read_word(pBMP + 28);
  if (i16 != 1) // must be 1 bit per pixel
     return -1;
  iOffBits = pgm_read_word(pBMP + 10);
  iPitch = 12;
  if (bFlipped)
  {
    iPitch = -12;
    iOffBits += (67 * 12); // start from bottom
  }

// rotate the data and send it to the display
  for (y=0; y<9; y++) // 8 lines of 8 pixels and 1 line of 4 pixels
  {
     int n=8; // number of pixel rows per byte
     hx1230SetPosition(0, y);
     if (y == 8) n = 4; // last row only has 4 lines
     for (j=0; j<3; j++) // do 3 sections of 32 columns (96 pixels across)
     {
         s = &pBMP[iOffBits + (j*4) + (y * iPitch*8)]; // source line
         memset(ucTemp, 0, 32); // start with all black
         for (x=0; x<32; x+=8) // do each block of 32x8 pixels
         {
            dst_mask = 1;
            for (q=0; q<n; q++) // gather 8 (or 4) rows
            {
               b = pgm_read_byte(s + (q * iPitch));
               for (z=0; z<8; z++) // gather up the 8 bits of this column
               {
                  if (b & 0x80)
                      ucTemp[x+z] |= dst_mask;
                  b <<= 1; 
               } // for z
               dst_mask <<= 1;
            } // for q
            s++; // next source byte
         } // for x
         hx1230WriteDataBlock(ucTemp, 32);
     } // for j
  } // for y
  return 0;
} /* hx1230LoadBMP() */

#ifdef BACKING_RAM
//
// Set (or clear) an individual pixel
// A local copy of the frame buffer is needed since we can't
// read data from the display
//
void hx1230SetPixel(int x, int y, unsigned char ucColor)
{
int i;
unsigned char uc, ucOld;

  i = ((y >> 3) * 96) + x;
  if (i < 0 || i > 863) // off the screen
    return;
  uc = ucOld = ucScreen[i];
  uc &= ~(0x1 << (y & 7));
  if (ucColor)
  {
    uc |= (0x1 << (y & 7));
  }
  if (uc != ucOld) // pixel changed
  {
    hx1230SetPosition(x, y>>3);
    hx1230WriteDataBlock(&uc, 1);
  }
} /* hx1230SetPixel() */
#endif
//
// Read the pixel at the given x,y
// if the library is not initialized, or the coordinates are
// not within the valid range, it returns 0
// Since we can't read the display memory, the pixel data
// is read from the local copy of the frame buffer
//
#ifdef BACKING_RAM
int hx1230GetPixel(int x, int y)
{
uint8_t c = 0;
int i = ((y >> 3) * 96) + x;
   if (i >= 0 && i <= 863) // on the screen
      c = (ucScreen[i] & (1<< (y & 7)));
   return c;
} /* hx1230GetPixel() */
#endif

//
// Invert font data
//
void InvertBytes(byte *pData, byte bLen)
{
byte i;
   for (i=0; i<bLen; i++)
   {
      *pData = ~(*pData);
      pData++;
   }
} /* InvertBytes() */
//
// Delays of up to 60000 us
// This is not accurate, but is good enough
// to initialize the display controller
// which allows enough time for the high/low signals to get latched
//
void delay_us(uint16_t us)
{
  while (us)
  {
    __asm__ volatile (
        "nop" "\n\t"
        "nop" "\n\t"
        "nop" "\n\t"
        "nop"
    );
    us--;
  }
} /* delay_us() */
//
// Draw a string of small (6x8), normal (8x8) or large (16x16 or 16x32) characters
// At the given col+row
int hx1230WriteString(uint8_t x, uint8_t y, char *szMsg, uint8_t iSize, uint8_t bInvert)
{
int i;
unsigned char c, ucTemp[64];
const unsigned char *s;

  if (iSize == FONT_LARGE) // draw 16x32 font (or stretched 8x8 if on AVR)
  {
    i = 0;
    while (x < 96-15 && szMsg[i] != 0)
    {
// stretch the 'normal' font instead of using the big font
// to save FLASH space on AVR
#ifdef __AVR__
          int tx, ty;
          c = szMsg[i] - 32;
          unsigned char uc1, uc2, ucMask, *pDest;
          s = (unsigned char *)&ucFont[(int)c*8];
          memcpy_P(ucTemp, s, 8);
          if (bInvert)
              InvertBytes(ucTemp, 8);
          // Stretch the font to double width + double height
          memset(&ucTemp[8], 0, 32); // write 32 new bytes
          for (tx=0; tx<8; tx++)
          {
              ucMask = 3;
              pDest = &ucTemp[8+tx*2];
              uc1 = uc2 = 0;
              c = ucTemp[tx];
              for (ty=0; ty<4; ty++)
              {
                  if (c & (1 << ty)) // a bit is set
                      uc1 |= ucMask;
                  if (c & (1 << (ty + 4)))
                      uc2 |= ucMask;
                  ucMask <<= 2;
              }
              pDest[0] = uc1;
              pDest[1] = uc1; // double width
              pDest[16] = uc2;
              pDest[17] = uc2;
          }
          hx1230SetPosition(x, y);
          hx1230WriteDataBlock(&ucTemp[8], 16);
          hx1230SetPosition(x, y+1);
          hx1230WriteDataBlock(&ucTemp[24], 16);
#else
      s = &ucBigFont[(unsigned char)(szMsg[i]-32)*64];
      memcpy_P(ucTemp, s, 64);
      if (bInvert)
         InvertBytes(ucTemp, 64);
      hx1230SetPosition(x, y);
      hx1230WriteDataBlock(ucTemp, 16);
      hx1230SetPosition(x, y+1);
      hx1230WriteDataBlock(&ucTemp[16], 16);  
      hx1230SetPosition(x, y+2);
      hx1230WriteDataBlock(&ucTemp[32], 16);  
      hx1230SetPosition(x, y+3);
      hx1230WriteDataBlock(&ucTemp[48], 16);  
#endif // __AVR__
      i++;
      x += 16;
    } // while
  }
  if (iSize == FONT_NORMAL)// draw 8x8 font
   {
    hx1230SetPosition(x, y);
    i = 0;
    while (x < 96-7 && szMsg[i] !=0)
    {
      s = &ucFont[(unsigned char)(szMsg[i]-32) * 8];
      memcpy_P(ucTemp, s, 8); // copy from FLASH memory
      if (bInvert)
         InvertBytes(ucTemp, 8);
      hx1230WriteDataBlock(ucTemp, 8); // write character pattern
      i++;
      x += 8;
    } // while
   }
   else if (iSize == FONT_SMALL) // 6x8
   {
    hx1230SetPosition(x, y);
    i = 0;
    while (x < 96-5 && szMsg[i] !=0)
    {
      s = &ucSmallFont[(unsigned char)(szMsg[i]-32) * 6];
      memcpy_P(ucTemp, s, 6); // copy from FLASH memory
      if (bInvert)
         InvertBytes(ucTemp, 6);
      hx1230WriteDataBlock(ucTemp, 6); // write character pattern
      i++;
      x += 6;
    } // while
   }
  return 0;
} /* hx1230WriteString() */

// Fill the frame buffer with a byte pattern
// e.g. all off (0x00) or all on (0xff)
void hx1230Fill(byte ucData)
{
int x, y;
byte temp[32];

  memset(temp, ucData, 32);
  for (y=0; y<9; y++)
  {
    hx1230SetPosition(0,y); // set to (0,Y)
    for (x=0; x<3; x++)
    {
      hx1230WriteDataBlock(temp, 32); // fill with data byte
    } // for x
  } // for y;
} /* hx1230Fill() */

